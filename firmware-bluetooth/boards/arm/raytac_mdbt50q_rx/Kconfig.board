## firmware-bluetooth/boards/arm/raytac_mdbt50q_rx/Kconfig.board
```kconfig
# Raytac MDBT50Q-RX board configuration

# Copyright (c) 2020 Tobias Svehagen
# SPDX-License-Identifier: Apache-2.0

config BOARD_RAYTAC_MDBT50Q_RX
	bool "Raytac MDBT50Q-RX"
	depends on SOC_NRF52840_QIAA
```

## firmware-bluetooth/boards/arm/raytac_mdbt50q_rx/Kconfig.defconfig
```kconfig
# Raytac MDBT50Q-RX board configuration

# Copyright (c) 2020 Tobias Svehagen
# SPDX-License-Identifier: Apache-2.0

if BOARD_RAYTAC_MDBT50Q_RX

config BOARD
	default "raytac_mdbt50q_rx"

config BT_CTLR
	default BT

endif # BOARD_RAYTAC_MDBT50Q_RX
```
